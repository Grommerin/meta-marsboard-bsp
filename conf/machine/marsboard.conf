## conf/machine/marsboard.conf
```bitbake
#@TYPE: Machine
#@NAME: embest-tech MarSboard 
#@SOC: i.MX6D
#@DESCRIPTION: Machine configuration for embest-tech MarSboard
#@MAINTAINER: Frank Bauernoeppel marsboard@bauernoeppel.de

include conf/machine/include/imx-base.inc
include conf/machine/include/tune-cortexa9.inc

SOC_FAMILY = "mx6:mx6q"
KERNEL_DEVICETREE ?= "imx6q-marsboard.dtb"
KERNEL_IMAGETYPE = "uImage"

PREFERRED_PROVIDER_virtual/bootloader = "u-boot-marsboard"
UBOOT_MACHINE ?= "marsboard_config"

PREFERRED_PROVIDER_virtual/kernel ?= "linux-marsboard"
PREFERRED_VERSION_linux-marsboard ?= "3.10.53"
# PREFERRED_VERSION_linux-bars3000 ?= "3.14.52"

# if no PREFERRED_PROVIDER is specified, linux-imx-3.14.28 will be used

# Use SPI NOR U-Boot by default
IMAGE_BOOTLOADER ?= ""

SERIAL_CONSOLE = "115200 ttymxc1"

SOC_DEFAULT_IMAGE_FSTYPES += " sdcard.gz"
SOC_DEFAULT_IMAGE_FSTYPES_mxs += " sdcard.gz"
```
